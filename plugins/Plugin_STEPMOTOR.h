#pragma once
// ============================================================
//  Plugin_STEPMOTOR.h  –  M5Stack Module13.2 Step Motor Driver v1.1
//
//  STACKABLE module — sits on the M-Bus / internal I2C bus.
//  I2C address 0x27.
//
//  ⚠ THIS PLUGIN COVERS THE I2C SIDE ONLY.
//  The v1.1 module is a HYBRID:
//    • An on-board MCU exposes a small I2C register set at 0x27
//      for monitoring and enable/reset control — that is what
//      this plugin implements.
//    • The actual motion — STEP / DIR pulse trains for the three
//      HR8825 axes — is generated by the HOST's GPIO pins routed
//      through the M-Bus (STEP_X/DIR_X … STEP_Z/DIR_Z).  That is
//      NOT carried over I2C and is NOT handled here; it needs the
//      planned non-I2C pin layer.  See the project's
//      "Non-I2C Device Layer - Design Plan.md".
//
//  ── I2C register map ─────────────────────────────────────────
//  Verified against the M5Stack document
//  "Step Motor Module V1.1 I2C Protocol V3 (FW Version)", 2022-04-20:
//
//    0x00  Limit    R    low 4 bits = 4 limit-switch inputs
//    0x01  Enable   W    write 0x00 = motors ENABLED,
//                        write 0x10 = motors DISABLED
//    0x02  Fault    R    low 3 bits = 3 driver fault flags (X/Y/Z)
//    0x03  Reset    R/W  low 3 bits = 3 driver reset controls (X/Y/Z)
//    0xFE  Version  R    firmware version number
//    0xFF  Address  R/W  I2C address 1-127  (not exposed by this plugin)
//
//  MONITORING — the four limit inputs and three fault flags are
//  reported as readings (limit1..limit4, fault1..fault3), along
//  with the last commanded enable state.
//
//  CONTROLLABLE — drive it via the Web API only:
//    GET /api/stepmotor/set?enable=1     energise the drivers
//    GET /api/stepmotor/set?enable=0     de-energise (motors coast)
//    GET /api/stepmotor/set?reset=2      driver reset bits, 0-7 bitmap
//                                        (bit0 = X, bit1 = Y, bit2 = Z)
//  Validation:
//    enable — 0/1 (or on/off).  Per the protocol's inverted encoding
//             enable=1 writes 0x00 and enable=0 writes 0x10.
//    reset  — 0-7, written verbatim to the Reset register (0x03).
//  There is deliberately NO dir / speed / move command: those are
//  motion, and motion is host-GPIO (see the hybrid note above).
// ============================================================
#include "../src/IDevice.h"

class Plugin_STEPMOTOR : public IDevice {
 public:
  // ── Register map (M5Stack Step Motor V1.1 I2C Protocol V3) ──
  static constexpr uint8_t REG_LIMIT = 0x00;    // R   bits 0-3
  static constexpr uint8_t REG_ENABLE = 0x01;   // W   0x00=on, 0x10=off
  static constexpr uint8_t REG_FAULT = 0x02;    // R   bits 0-2
  static constexpr uint8_t REG_RESET = 0x03;    // R/W bits 0-2
  static constexpr uint8_t REG_VERSION = 0xFE;  // R
  static constexpr uint8_t ENABLE_ON = 0x00;    // value that ENABLES motors
  static constexpr uint8_t ENABLE_OFF = 0x10;   // value that DISABLES motors

  const char* name() const override { return "Step Motor Module v1.1"; }
  const char* slug() const override { return "stepmotor"; }

  void i2cAddresses(uint8_t* buf, uint8_t& n) const override {
    buf[0] = 0x27;
    n = 1;
  }
  I2CBus preferredBus() const override { return I2CBus::Internal; }
  MountType mount() const override { return MountType::Stackable; }
  bool controllable() const override { return true; }

  bool begin(TwoWire* wire, uint8_t a) override {
    bus = wire;
    addr = a;
    // Presence check — read the firmware-version register.  regRead
    // returns false if the module doesn't ACK.
    if (!regRead(REG_VERSION, &_fwVersion, 1))
      return false;
    // Safe initial state — motors de-energised.
    regWrite(REG_ENABLE, ENABLE_OFF);
    _enabled = false;
    return true;
  }

  void update() override {
    _limit = regRead8(REG_LIMIT) & 0x0F;  // 4 limit-switch inputs
    _fault = regRead8(REG_FAULT) & 0x07;  // 3 driver fault flags
    _reset = regRead8(REG_RESET) & 0x07;  // 3 driver reset controls
  }

  void toJson(JsonObject& o) const override {
    for (uint8_t i = 0; i < 4; i++)
      o[String("limit") + (i + 1)] = (_limit >> i) & 1;
    for (uint8_t i = 0; i < 3; i++)
      o[String("fault") + (i + 1)] = (_fault >> i) & 1;
    o["enabled"] = _enabled;
    o["reset_bits"] = _reset;
    o["fw_version"] = _fwVersion;
  }

  void getReadings(SensorVal* b, uint8_t& n) const override {
    uint8_t i = 0;
    static const char* lk[4] = {"limit1", "limit2", "limit3", "limit4"};
    for (uint8_t j = 0; j < 4; j++, i++)
      b[i] = {lk[j], static_cast<float>((_limit >> j) & 1), ""};
    static const char* fk[3] = {"fault1", "fault2", "fault3"};
    for (uint8_t j = 0; j < 3; j++, i++)
      b[i] = {fk[j], static_cast<float>((_fault >> j) & 1), ""};
    b[i++] = {"enabled", static_cast<float>(_enabled ? 1 : 0), ""};
    n = i;  // 8 readings
  }

  // ── Control ───────────────────────────────────────────────
  bool command(const String& param, const String& value) override {
    if (param == "enable") {
      int on = _parseBool(value);
      if (on < 0)
        return false;
      // Protocol uses an inverted encoding: 0x00 enables, 0x10 disables.
      if (!regWrite(REG_ENABLE, on ? ENABLE_ON : ENABLE_OFF))
        return false;
      _enabled = (on == 1);
      return true;
    }
    if (param == "reset") {
      int32_t v;
      if (!_parseInt(value, 0, 7, v))
        return false;  // 3-bit bitmap
      if (!regWrite(REG_RESET, static_cast<uint8_t>(v)))
        return false;
      _reset = static_cast<uint8_t>(v);
      return true;
    }
    // Unknown param.  Note: dir / speed / move are NOT I2C commands —
    // motion is generated on the host's STEP/DIR GPIO lines.
    return false;
  }

  // ── Control schema ────────────────────────────────────────
  //  An enable toggle plus the 3-bit driver-reset bitmap.  There
  //  is no motion control here — STEP/DIR is host-GPIO, not I2C.
  void controlSchema(JsonArray& out) const override {
    JsonObject en = out.add<JsonObject>();
    en["id"] = "enable";
    en["label"] = "Drivers energised";
    en["type"] = "toggle";
    en["group"] = "Control";
    en["value"] = _enabled ? 1 : 0;

    JsonObject rs = out.add<JsonObject>();
    rs["id"] = "reset";
    rs["label"] = "Driver reset (X/Y/Z bitmap)";
    rs["type"] = "slider";
    rs["min"] = 0;
    rs["max"] = 7;
    rs["step"] = 1;
    rs["group"] = "Control";
    rs["value"] = _reset;
  }

 private:
  uint8_t _limit = 0;      // 4 limit-switch inputs   (bits 0-3)
  uint8_t _fault = 0;      // 3 driver fault flags    (bits 0-2)
  uint8_t _reset = 0;      // 3 driver reset controls (bits 0-2)
  uint8_t _fwVersion = 0;  // firmware version, read once at begin()
  bool _enabled = false;   // mirror of last enable command (0x01 is W-only)

  static int _parseBool(const String& v) {
    String t = v;
    t.toLowerCase();
    if (t == "1" || t == "on" || t == "true")
      return 1;
    if (t == "0" || t == "off" || t == "false")
      return 0;
    return -1;
  }
  static bool _parseInt(const String& v, int32_t lo, int32_t hi, int32_t& out) {
    if (v.length() == 0)
      return false;
    for (uint16_t i = 0; i < v.length(); i++)
      if (!isDigit(v.charAt(i)))
        return false;
    out = v.toInt();
    return (out >= lo && out <= hi);
  }
};
